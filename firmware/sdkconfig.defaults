## main/Kconfig.projbuild
```kconfig
menu "EspRangeTest"

config RT_SIM_PEER
    bool "Inject a simulated peer"
    default y
    help
        Fabricates a peer that fades in and out, dropping progressively more packets, so
        the observation table and the serial report can be exercised on a single board
        with no radios implemented and nothing else on the bench.

        This is bring-up scaffolding. Turn it off before collecting anything that matters.
        While it is on, every report prints a line saying the readings are simulated.

endmenu
```
